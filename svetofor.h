#ifndef Svetofor_h
#define Svetofor_h

#define LED_PIN 26
#define LED_NUM 256
#include "FastLED.h"
//#define BRIGHT 50
#define LED_TYPE    WS2811
#define COLOR_ORDER GRB
//CRGB leds[NUM_LEDS];
#define UPDATES_PER_SECOND 1
//новое табло 16*16
//#define DEBUG

#define PIN_LINE 16 // количество элементов в модуле
/*
Ебучие китайцы спаяли модуль змейкой. поэтому адресация на каждой строке идет в обратную сторону
16	15	14	13	12	11	10	9  	8	  7	  6	  5	  4	  3  	2 	1
17	18	19	20	21	22	23	24	25	26	27	28	29	30	31	32
48	47	46	45	44	43	42	41	40	39	38	37	36	35	34	33
49	50	51	52	53	54	55	56	57	58	59	60	61	62	63	64
.....
*/
const bool DIGIT_X[] PROGMEM ={
1,1,1,1,1,1,1,1,1,1,1,1,1,1,1,1,
1,0,0,0,0,0,0,0,0,0,0,0,0,0,0,1,
1,0,1,1,0,0,0,0,0,0,0,0,1,1,0,1,
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1,1,1,1,1,1,1,1,1,1,1,1,1,1,1,1
};

const bool DIGIT_9[] PROGMEM ={
1,1,1,1,1,1,1,1,1,1,1,1,1,1,1,1,
1,0,0,0,0,0,0,0,0,0,0,0,0,0,0,1,
1,0,0,0,0,1,1,1,1,1,0,0,0,0,0,1,
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1,1,1,1,1,1,1,1,1,1,1,1,1,1,1,1
};
const bool DIGIT_8[] PROGMEM ={
1,1,1,1,1,1,1,1,1,1,1,1,1,1,1,1,
1,0,0,0,0,0,0,0,0,0,0,0,0,0,0,1,
1,0,0,0,0,1,1,1,1,1,0,0,0,0,0,1,
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1,1,1,1,1,1,1,1,1,1,1,1,1,1,1,1
};
const bool DIGIT_7[] PROGMEM ={
1,1,1,1,1,1,1,1,1,1,1,1,1,1,1,1,
1,0,0,0,0,0,0,0,0,0,0,0,0,0,0,1,
1,0,0,1,1,1,1,1,1,1,1,1,0,0,0,1,
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1,1,1,1,1,1,1,1,1,1,1,1,1,1,1,1
};
const bool DIGIT_6[] PROGMEM ={
1,1,1,1,1,1,1,1,1,1,1,1,1,1,1,1,
1,0,0,0,0,0,0,0,0,0,0,0,0,0,0,1,
1,0,0,0,0,0,1,1,1,1,1,0,0,0,0,1,
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1,1,1,1,1,1,1,1,1,1,1,1,1,1,1,1
};
const bool DIGIT_5[] PROGMEM ={
1,1,1,1,1,1,1,1,1,1,1,1,1,1,1,1,
1,0,0,0,0,0,0,0,0,0,0,0,0,0,0,1,
1,0,0,0,1,1,1,1,1,1,1,0,0,0,0,1,
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1,1,1,1,1,1,1,1,1,1,1,1,1,1,1,1
};
const bool DIGIT_4[] PROGMEM ={
1,1,1,1,1,1,1,1,1,1,1,1,1,1,1,1,
1,0,0,0,0,0,0,0,0,0,0,0,0,0,0,1,
1,0,0,0,0,0,0,0,0,1,1,0,0,0,0,1,
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1,1,1,1,1,1,1,1,1,1,1,1,1,1,1,1
};
const bool DIGIT_3[] PROGMEM ={
1,1,1,1,1,1,1,1,1,1,1,1,1,1,1,1,
1,0,0,0,0,0,0,0,0,0,0,0,0,0,0,1,
1,0,0,0,1,1,1,1,1,1,0,0,0,0,0,1,
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1,1,1,1,1,1,1,1,1,1,1,1,1,1,1,1
};
const bool DIGIT_2[] PROGMEM ={
1,1,1,1,1,1,1,1,1,1,1,1,1,1,1,1,
1,0,0,0,0,0,0,0,0,0,0,0,0,0,0,1,
1,0,0,0,1,1,1,1,1,1,0,0,0,0,0,1,
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1,1,1,1,1,1,1,1,1,1,1,1,1,1,1,1
};
const bool DIGIT_1[] PROGMEM ={
1,1,1,1,1,1,1,1,1,1,1,1,1,1,1,1,
1,0,0,0,0,0,0,0,0,0,0,0,0,0,0,1,
1,0,0,0,0,0,0,1,1,0,0,0,0,0,0,1,
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1,1,1,1,1,1,1,1,1,1,1,1,1,1,1,1
};
const bool DIGIT_FINISH[] PROGMEM ={
0,0,0,0,1,1,1,1,0,0,0,0,1,1,1,1,
0,0,0,0,1,1,1,1,0,0,0,0,1,1,1,1,
0,0,0,0,1,1,1,1,0,0,0,0,1,1,1,1,
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1,1,1,1,0,0,0,0,1,1,1,1,0,0,0,0
};
const bool DIGIT_0[] PROGMEM ={
0,0,0,0,0,0,0,0,0,0,0,0,0,0,0,0,
0,0,0,1,0,0,0,0,0,0,0,0,0,0,0,0,
0,0,0,0,0,1,1,1,1,1,0,0,0,0,0,0,
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0,0,0,0,0,0,0,0,0,0,0,0,0,0,0,0
};

#define COLOR_RED CRGB(255,0,0)
#define COLOR_WHITE CRGB(255,255,255)
const int startTime=5;
const int lapGigit=10;
const int stateRedFlag=11;
const int stateGreenFlag=12;
const int stateYellowFlag=13;
const int stateFinishFlag=14;

class Svetofor{  // управление адресной лентой? 
private: 
    bool counting;
    bool haswifiError;
    int counter;
    int lastMilis; 
    int lastState;
    void fillLEDColors( uint8_t red,uint8_t green, uint8_t blue ){ 
    for( int i = 0; i < LED_NUM; ++i) {
        leds[i] = CRGB(red,green,blue );
    }
    }
    

     void drawDigit(const bool *arrDigit, CRGB   color){
       int calc_i=0;
         for( int i = 0; i < LED_NUM; ++i) {
            if ((i / PIN_LINE+1)%2==1){
                calc_i=(PIN_LINE-1)-(i%PIN_LINE)+(i/PIN_LINE)*(PIN_LINE);
            } else {
               calc_i=i;
            }       
            if (arrDigit[calc_i]){
              leds[i] =  color;
            } else {
              leds[i] = CRGB::Black; //CRGB(0,0,0);
            };
        };
         //FastLED.show();
       //  DEBUG_PRINT(leds);
         // FastLED.delay(1000 / UPDATES_PER_SECOND);
     }; 
     void nextDigit(int count, CRGB   color){   
         // Serial.println(counter);
        if (lastState<lapGigit)  lastState=count;
            switch (count){
              case 0: 
              drawDigit(DIGIT_0,color);
                break;
              case 1: 
              drawDigit(DIGIT_1,color);
                break;
              case 2: 
              drawDigit(DIGIT_2,color);
                break;
              case 3: 
              drawDigit(DIGIT_3,color);
                break;
              case 4: 
              drawDigit(DIGIT_4,color);
                break;
              case 5: 
              drawDigit(DIGIT_5,color);
                break;
              case 6: 
              drawDigit(DIGIT_6,color);
                break;
              case 7: 
              drawDigit(DIGIT_7,color);
                break;
              case 8: 
              drawDigit(DIGIT_8,color);
                break;
              case 9: 
              drawDigit(DIGIT_9,color);
                break;
              case 10: 
              drawDigit(DIGIT_X,color);
                break;  
            };
        
    }; 


public:
    CRGB leds[LED_NUM];

    Svetofor(int none){
      counting=false;
      counter=startTime;
      lastMilis=0;
      //stopRace();
    };

    void wifiError(){    //красный крест
     haswifiError=true;
            nextDigit(10, CRGB::Red);  //fill RED 
            FastLED.show();
            //DEBUG_PRINT("showRED");
           //  FastLED.delay(1000 / UPDATES_PER_SECOND);
            Serial.println("WiFi Error!");
    };  //стоим, ждем следующий заезд

    void setLastState(){

        if  (haswifiError) {
          DEBUG_PRINT("setiing Last state");
          DEBUG_PRINT(lastState);
        if (lastState<lapGigit){
            nextDigit(lastState, CRGB::Green);  //на обратном отсчете потерю WiFi не успеем поймать?
           
        } else {
          if (lastState==stateRedFlag)  fillLEDColors(255,0,0 );  //fill RED 
           if (lastState==stateGreenFlag)  fillLEDColors(0,255,0 );  //fill RED 
           if (lastState==stateYellowFlag)  fillLEDColors(255,255,0 );  //fill RED 
           if (lastState==stateFinishFlag)  drawDigit(DIGIT_FINISH,CRGB::White);  //fill RED 
        }
        FastLED.show(); 
        haswifiError=false;
        }
    };


    void stopRace(){    //красный флаг
     //  if (adressLogic){
            fillLEDColors(255,0,0 );  //fill RED 
            FastLED.show();
            //DEBUG_PRINT("showRED");
           //  FastLED.delay(1000 / UPDATES_PER_SECOND);
            Serial.println("Красный ФЛАГ!");
            lastState=stateRedFlag;
    };  //стоим, ждем следующий заезд

    void startRace(){  // начать отсчет
      counting=true;
      counter=startTime;
      Serial.println("начат отсчет");
    }; //начать старт заезда

    bool startRaceExecute(int lap){
       if (counting){  //тут будет таймер вызова nextDigit
          if (millis()-lastMilis>1000ul){
            lastMilis=millis();
            nextDigit(counter, CRGB::Red);
            Serial.println("tik");
            if (counter==0){
                fillLEDColors(0,255,0 );  //fill GREEN 
                counting=false;
                Serial.println("RUNRUNRUN!!!!!!! ");
                lastState=stateGreenFlag;
            };
            counter--;
          };
       } else {
         if (lap > 0) {
            nextDigit(lap, CRGB::Green);
         }; 
       };
       return counting;
    }; //начать старт заезда 

    void setFinish(){   //клетчатый флаг
          drawDigit(DIGIT_FINISH,CRGB::White);
          FastLED.show();
         // DEBUG_PRINT("showKLET");
         //  FastLED.delay(1000 / UPDATES_PER_SECOND);
          Serial.println("Клетчатый ФЛАГ!");
          lastState=stateFinishFlag;
    };    //финиш

    void setWarning(){
       fillLEDColors(255,255,0 );  //fill YELLOW 
       FastLED.show();
       //  FastLED.delay(1000 / UPDATES_PER_SECOND);
        Serial.println("Желтый ФЛАГ!");
       // DEBUG_PRINT("showYELLOW");
       lastState=stateYellowFlag;
    };   //желтый флаг

};

#endif